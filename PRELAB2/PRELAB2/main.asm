
;-----------------------------------------------
; Universidad del Valle de Guatemala
; IE2023: Programacion de Microcontroladores
; PRELAB_SEGMENTO.asm
; Autor: ANTHONY ALEJANDR BOTEO LсPEZ
; Proyecto: LABORATORIO 2
; Hardware: ATMEGA328P
; Creado: 13/02/2025 
; Ultima modificacion: 13/02/2025
; DescripciСn:
;-----------------------------------------------


.include "M328PDEF.inc"
.cseg
.org	  0x0000
.def	  COUNTER = R17	//DEFINIMOS VARIABLE GLOBAL COUNTER

//DEFINICION DE REGISTROS
// R16: REGISTROS GENERALES
// R17: COUNTER
// R18: CONTADOR1

/////////////////CONFIGURACION PILA//////////////
LDI		R16, LOW(RAMEND)
OUT		SPL, R16
LDI		R16, HIGH(RAMEND)
OUT		SPH, R16

////////////////CONFIGURACION MCU///////////////
SETUP: 

	//CONFIGURANDO EL PRESCALER
	LDI		R16, (1 << CLKPCE)	//HABILITAR CAMBIO EN CLKPCE
	STS		CLKPR, R16			
	LDI		R16, 0b00000100
	STS		CLKPR, R16

	//INICIAR TIMER
	CALL	INIT_TMR0

	//CONFIGURAR PINES DE SALIDA
	LDI		R16, 0xFF			//ACTIVAR PORTD COMO SALIDAS
	OUT		DDRB, R16	
	OUT		DDRD, R16
	LDI		R16, 0x00			//DESCARTIVAR PULL UP EN TODO PORTD
	OUT		PORTB, R16
	OUT		PORTD, R16

	//CONFIGURAR EL COUNTER CON UN VALOR INICIAL
	LDI		COUNTER, 0x00		//EL VALOR INICIAL PARA CONTAR ES DE 0
	LDI		R18, 0x00

MAIN:
	
	IN		R16, TIFR0			//LEER REGISTRO DE TIMER 0
	SBRS	R16, TOV0			//SALTO SI EL BIT 0 EN TOV0 = 1, YA TERMINO DE CONTAR
	RJMP	MAIN
	SBI		TIFR0, TOV0			//LIMPIAR BANDERA DE OVERFLOW
	LDI		R16, 100			// VALOR QUE SE CARGA AL TEMPORIZADOR PARA CONTAR
	OUT		TCNT0, R16			//VOLVER A CARGAR EL EN EL REGISTRO PARA VOLVER A CONTAR
	INC		COUNTER				
	CPI		COUNTER, 10			//HACE LA COMPARACIсN SI ES IGUAL A 10(QUE TAN RAPIDO CUENTA)
	BRNE	MAIN
	CLR		COUNTER				//SI COUNTER LLEGA A 10 EL COUNTER SE SETEA EN 0

	//CONTADOR 4 BITS
	INC		R18					//INCREMENTA EL VALOR EN 1
	//ANDI	R18, 0x0F			//SOLO MANTIENE LOS 4 BITS
	OUT		PORTB, R18			
	OUT		PORTD, R18			//PRUEBA, NO ESTA EN EL ARCHIVO DE ENTREGA
	RJMP	MAIN

INIT_TMR0:

	LDI		R16, (1<<CS01) | (1<<CS00) //PRESCALER 64
	OUT		TCCR0B, R16				   //ACTIVA EL PRESCALER EN TCCR0B
	LDI		R16, 100				   //VALOR DESDE DONDE INICIAMOS
	OUT		TCNT0, R16				   //CARGA EL VALOR A TCNT0 
	RET


