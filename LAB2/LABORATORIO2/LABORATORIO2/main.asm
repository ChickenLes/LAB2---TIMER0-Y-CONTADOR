;-----------------------------------------------
; Universidad del Valle de Guatemala
; IE2023: Programacion de Microcontroladores
; CONTADOR_POSTLAB.asm
; Autor: ANTHONY ALEJANDRO BOTEO LсPEZ
; Proyecto: LABORATORIO_2
; Hardware: ATMEGA328P
; Creado: 14/02/2025 
; Ultima modificacion: 12/02/2025
; DescripciСn:
;-----------------------------------------------

/////////////CONFIGURACION GENERAL//////////////////////////////////////
.include "M328PDEF.inc"

.cseg
.org	0x0000
.def	COUNTER = R21 //DEFINICION DE VARIABLE GLOBAL EN REGISTRO R17

//////////////////////CONFIGURACION TIMER/////////////////
LDI R16, (1 << CLKPCE)    ; Habilitar cambios en CLKPR (CLKPCE = 1)
STS CLKPR, R16   ; Escribir en CLKPR para desbloquear cambios
LDI R16, 0b00000100    ; Configurar prescaler a 8 (8 MHz / 8 = 1 MHz)
STS CLKPR, R16   ; Aplicar prescaler

//INICIAR TIMER
	CALL	INIT_TMR0

//PILA
LDI		R16, LOW(RAMEND)
OUT		SPL, R16
LDI		R16, HIGH(RAMEND)
OUT		SPH, R16

//REGISTROS
//R16: REGISTRO GENERAL
//R18: CONTADOR DISPLAY
//R19: DELAY
//R20: REGISTRO DE COPIA DISPLAY
//R21: DEFINIDO COMO COUNTER
//R22: CONTADOR 4BITS LEDS

DATA:

	//.DB	 0x3E,0x30,0x6D,0x79,0x33,0x5B,0x5F,0x70,0x7F,0x7B,0x77,0x7F,0x4E,0x7E,0x4F,0x47
	//.DB	 0x7E, 0x30, 0x6D,0x79,0x33,0x5B,0x5F,0x70,0x7F,0x7B,0x77,0x7F,0x4E,0x7E,0x4F,0x47
	.DB 0x3F, 0x06, 0x5B, 0x4F, 0x66, 0x6D, 0x7D, 0x07, 0x7F, 0x6F,0x77, 0x7C, 0x39, 0x5E, 0x79, 0x71
SETUP:

	//CONFIGURANDO SALIDAS
	LDI		R16, 0xFF
	OUT		DDRD, R16	//TODO PORTD COMO SALIDA
	OUT		DDRB, R16	//TODO PORTB COMO SALIDA
	LDI		R16, 0x00
	OUT		PORTD,	R16	//TODO PORTD PULL UP DESACTIVADO
	OUT		PORTB, R16  //TODO PORTD PULL UP DESACTIVADO
	 
	//CONFIGURANDO INPUTS
	LDI		R16, 0x20
	OUT		DDRC, R16	//TODO PORTC COMO INPUT
	LDI		R16, 0x1F
	OUT		PORTC, R16	//TODO PORTC PULL UP ACTIVADOD

	//PUNTERO
	LDI		ZH, HIGH(DATA << 1)
	LDI		ZL, LOW(DATA << 1)
	LPM		R16, Z
	OUT		PORTD, R16

	//APAGAR LEDS ARDUINO
	LDI		R16, 0x00
	STS		UCSR0B, R16

	//CONFIGURACIONES INICIALES
	LDI		R17, 0xFF	//GUARDA EL VALOR DEL CONTADOR
	LDI		R18, 0x00	//CONTADOR
	LDI		COUNTER, 0x00
	LDI		R22, 0x00
	OUT		PORTD, R18
	OUT		PORTB, R22

	

///////////////////ANTI_REBOTE///////////////////////////
ANTI_REBOTE:

	//ANTIREBOTE
	IN		R16, PINC
	CP		R17, R16
	BREQ	ANTI_REBOTE
	
	CALL	DELAY
	IN		R16, PINC	//VERIFICAR QUE SI EL ESTADO DE LECTURA ES CORRECTO	
	CP		R17, R16
	BREQ	ANTI_REBOTE

	MOV		R17, R16	//GUARDA EL NUEVO ESTADO(POR SI SE MANTIENE PRESIONADO)


	CALL	CONTROL1	//CONTROL SUMA
	RJMP	ANTI_REBOTE	

CONTROL1:

	CPI		R16, 0x1E	//COMPARA EL VALOR CON 0001 111"0" EN PINC0
	BREQ	AUMENTO

	CPI		R16, 0x1D	//COMPARA EL VALOR CON 0001 11"0"1 EN PINC1
	BREQ	DECREMENTO
	RET

AUMENTO:

	INC		R18
	CPI 	R18, 0x10	//COMPARA CON 16
	BRNE	DISPLAY		
	LDI		R18, 0x00
	RJMP	DISPLAY
	
DECREMENTO:

	DEC		R18
	BRPL	DISPLAY		//VEMOS LA BANDERA NEGATIVA N = 0 SALTA, N = 1 NO SALTA
	LDI		R18, 0x0F
	RJMP	DISPLAY

DISPLAY:

	LDI ZH, HIGH(DATA << 1)
	LDI ZL, LOW(DATA << 1)	//PUNTERO APUNTA A LA TABLA Z
	ADD ZL, R18				//AЯadir el valor del contador R20 al puntero Z para obtener la salida en PORTD
	LPM R20, Z				//Copia el valor guardado en el nuevo Z
	OUT PORTD, R20			//Modifico el 7 segmentos en PORTD

	RJMP	ANTI_REBOTE


////////////////////////////INIT_TMR0///////////////////////////
INIT_TMR0:

	LDI		R16, (1<<CS01) | (1<<CS00) //PRESCALER 64
	OUT		TCCR0B, R16				   //ACTIVA EL PRESCALER EN TCCR0B
	LDI		R16, 100				   //VALOR DESDE DONDE INICIAMOS
	OUT		TCNT0, R16				   //CARGA EL VALOR A TCNT0 
	RET


/////////////////////////////// DELAY /////////////////////////
DELAY:
    LDI     R19, 0xFF
SUB_DELAY1:
    DEC     R19
    CPI     R19, 0
    BRNE    SUB_DELAY1
    LDI     R19, 0xFF
SUB_DELAY2:
	DEC     R19
    CPI     R19, 0
    BRNE    SUB_DELAY2
    LDI     R19, 0xFF
SUB_DELAY3:
	DEC     R19
    CPI     R19, 0
    BRNE    SUB_DELAY3
	RET